## Kconfig
```kconfig
# Top-Level Kconfig for Zephyr Example Module
#
# Copyright (c) 2020, Friedt Professional Engineering Services, Inc
#
# SPDX-License-Identifier: Apache-2.0

source "subsys/zephyr_example_module/Kconfig"
```

## dts/bindings/zephyr_example_module/zephyr,zephyr-example-module.yaml
```yaml
# Devicetree Bindings for Zephyr Example Module
#
# Copyright (c) 2020, Friedt Professional Engineering Services, Inc
#
# SPDX-License-Identifier: Apache-2.0

description: Devicetree Bindings for Zephyr Example Module

compatible: "zephyr,zephyr-example-module"

include: [base.yaml]

properties:
    "max-iterations":
      type: int
      required: true
      description: Maximum number of Fibonacci sequence values to calculate before restarting
    "#address-cells":
      type: int
      required: false
      default: 1
      const: 1
    "#size-cells":
      type: int
      required: false
      default: 0
      const: 0
```

## subsys/zephyr_example_module/Kconfig
```kconfig
# Kconfig - Zephyr Example Module configuration options
#
# Copyright (c) 2020 Friedt Professional Engineering Services, Inc
#
# SPDX-License-Identifier: Apache-2.0

menuconfig ZEPHYR_EXAMPLE_MODULE
	bool "Zephyr Example Module"
	help
	  This option enables Zephyr Example Module support.

if ZEPHYR_EXAMPLE_MODULE

module = ZEPHYR_EXAMPLE_MODULE
module-str = zephyr_example_module
#source "subsys/logging/Kconfig.template.log_config"

endif # ZEPHYR_EXAMPLE_MODULE
```

## west.yml
```yaml
# West file for Zephyr Example Module
#
# Copyright (c) 2020, Friedt Professional Engineering Services, Inc
#
# SPDX-License-Identifier: Apache-2.0

manifest:
  remotes:
    - name: zephyrproject-rtos
      url-base: https://github.com/zephyrproject-rtos
  projects:
    - name: zephyr
      remote: zephyrproject-rtos
      revision: 310d149d8b612035a53e0d71204fa9cd29a131ab
      import: true
```
