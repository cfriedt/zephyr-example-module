## CMakeLists.txt
```
# CMakeLists.txt for Zephyr Example Module sample
#
# Copyright (c) 2020, Friedt Professional Engineering Services, Inc
#
# SPDX-License-Identifier: Apache-2.0

cmake_minimum_required(VERSION 3.13.1)
include($ENV{ZEPHYR_BASE}/cmake/app/boilerplate.cmake NO_POLICY_SCOPE)
project(zephyr_sample_module)

target_sources(app PRIVATE src/main.c)
```

## sample.yaml
```
# Sample YAML for Zephyr Example Module
#
# Copyright (c) 2020, Friedt Professional Engineering Services, Inc
#
# SPDX-License-Identifier: Apache-2.0

sample:
  description: Zepher Example Module sample
  name: zephyr_example_module
common:
    tags: introduction
    integration_platforms:
      - native_posix
    harness: console
    harness_config:
      type: multi_line
      ordered: true
      regex:
        - "0"
        - "1"
        - "1"
        - "2"
        - "3"
        - "5"
        - "8"
        - "13"
tests:
  sample.zephyr_example_module:
    tags: introduction
```

## prj.conf
```kconfig
CONFIG_ZEPHYR_EXAMPLE_MODULE=y
```

## src/main.c
```c
/*
 * Copyright (c) 2109 Friedt Professional Engineering Services, Inc
 *
 * SPDX-License-Identifier: Apache-2.0
 */

void main(void)
{
}
```
